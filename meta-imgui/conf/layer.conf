## meta-imgui/conf/layer.conf
```bitbake
BBPATH .= ":${LAYERDIR}"

BBFILES += "${LAYERDIR}/recipes-*/*/*.bb ${LAYERDIR}/recipes-*/*/*.bbappend"

BBFILE_COLLECTIONS += "imgui-layer"
BBFILE_PATTERN_imgui-layer := "^${LAYERDIR}/"


BBFILE_PRIORITY_imgui-layer = "7"

LAYERVERSION_imgui-layer = "1"

#so far dunfell and will roll out for others later
LAYERSERIES_COMPAT_imgui-layer = "dunfell gatesgarth hardknott honister kirkstone langdale mickledore"

LICENSE_PATH += "${LAYERDIR}/licenses"

IMAGE_FEATURES[validitems] += "docking"

IMGUI_GIT_PROJECT ?= "imgui"
IMGUI_GIT ?= "${IMGUI_GIT_PROJECT}"
IMGUI_GIT_PROTOCOL ?= "git"
```
